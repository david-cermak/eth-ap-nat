## pppos-sta/host/main/Kconfig.projbuild
```kconfig
menu "Example Configuration"

    config BROKER_URL
        string "Broker URL"
        default "mqtt://mqtt.eclipseprojects.io"
        help
            URL of the broker to connect to

    config BROKER_URL_FROM_STDIN
        bool
        default y if BROKER_URL = "FROM_STDIN"

    choice EXAMPLE_CONNECT_PPP_DEVICE
        prompt "Choose PPP device"
        default EXAMPLE_CONNECT_PPP_DEVICE_UART
        help
            Select which peripheral to use to connect to the PPP server.

        config EXAMPLE_CONNECT_PPP_DEVICE_USB
            bool "USB"
            depends on SOC_USB_OTG_SUPPORTED
            select TINYUSB_CDC_ENABLED
            help
                Use USB ACM device.

        config EXAMPLE_CONNECT_PPP_DEVICE_UART
            bool "UART"
            help
                Use UART.

        config EXAMPLE_CONNECT_PPP_DEVICE_SPI
            bool "SPI"
            help
                Use SPI HD.

    endchoice

    menu "UART Configuration"
        depends on EXAMPLE_CONNECT_PPP_DEVICE_UART
        config EXAMPLE_CONNECT_UART_TX_PIN
            int "TXD Pin Number"
            default 4
            range 0 31
            help
                Pin number of UART TX.

        config EXAMPLE_CONNECT_UART_RX_PIN
            int "RXD Pin Number"
            default 5
            range 0 31
            help
                Pin number of UART RX.

        config EXAMPLE_CONNECT_UART_BAUDRATE
            int "UART Baudrate"
            default 115200
            range 9600 3000000
            help
                Baudrate of the UART device

    endmenu

    config EXAMPLE_PPP_CONN_MAX_RETRY
        int "Maximum retry"
        default 6
        help
            Set the Maximum retry to avoid station reconnecting if the pppd
            is not available

endmenu
```

## pppos-sta/slave/main/Kconfig.projbuild
```kconfig
menu "Example Configuration"

    config ESP_WIFI_SSID
        string "WiFi SSID"
        default "myssid"
        help
            SSID (network name) for the example to connect to.

    config ESP_WIFI_PASSWORD
        string "WiFi Password"
        default "mypassword"
        help
            WiFi password (WPA or WPA2) for the example to use.

    choice ESP_WIFI_SAE_MODE
        prompt "WPA3 SAE mode selection"
        default ESP_WPA3_SAE_PWE_BOTH
        help
            Select mode for SAE as Hunt and Peck, H2E or both.
        config ESP_WPA3_SAE_PWE_HUNT_AND_PECK
            bool "HUNT AND PECK"
        config ESP_WPA3_SAE_PWE_HASH_TO_ELEMENT
            bool "H2E"
        config ESP_WPA3_SAE_PWE_BOTH
            bool "BOTH"
    endchoice

    config ESP_WIFI_PW_ID
        string "PASSWORD IDENTIFIER"
        depends on  ESP_WPA3_SAE_PWE_HASH_TO_ELEMENT|| ESP_WPA3_SAE_PWE_BOTH
        default ""
        help
            password identifier for SAE H2E

    config ESP_MAXIMUM_RETRY
        int "Maximum retry"
        default 5
        help
            Set the Maximum retry to avoid station reconnecting to the AP unlimited when the AP is really inexistent.

    choice ESP_WIFI_SCAN_AUTH_MODE_THRESHOLD
        prompt "WiFi Scan auth mode threshold"
        default ESP_WIFI_AUTH_WPA2_PSK
        help
            The weakest authmode to accept in the scan mode.
            This value defaults to ESP_WIFI_AUTH_WPA2_PSK incase password is present and ESP_WIFI_AUTH_OPEN is used.
            Please select ESP_WIFI_AUTH_WEP/ESP_WIFI_AUTH_WPA_PSK incase AP is operating in WEP/WPA mode.

        config ESP_WIFI_AUTH_OPEN
            bool "OPEN"
        config ESP_WIFI_AUTH_WEP
            bool "WEP"
        config ESP_WIFI_AUTH_WPA_PSK
            bool "WPA PSK"
        config ESP_WIFI_AUTH_WPA2_PSK
            bool "WPA2 PSK"
        config ESP_WIFI_AUTH_WPA_WPA2_PSK
            bool "WPA/WPA2 PSK"
        config ESP_WIFI_AUTH_WPA3_PSK
            bool "WPA3 PSK"
        config ESP_WIFI_AUTH_WPA2_WPA3_PSK
            bool "WPA2/WPA3 PSK"
        config ESP_WIFI_AUTH_WAPI_PSK
            bool "WAPI PSK"
    endchoice

    choice EXAMPLE_CONNECT_PPP_DEVICE
        prompt "Choose PPP device"
        default EXAMPLE_CONNECT_PPP_DEVICE_UART
        help
            Select which peripheral to use to connect to the PPP server.

        config EXAMPLE_CONNECT_PPP_DEVICE_USB
            bool "USB"
            depends on SOC_USB_OTG_SUPPORTED
            select TINYUSB_CDC_ENABLED
            help
                Use USB ACM device.

        config EXAMPLE_CONNECT_PPP_DEVICE_UART
            bool "UART"
            help
                Use UART.

        config EXAMPLE_CONNECT_PPP_DEVICE_SPI
            bool "SPI"
            help
                Use SPI HD.

    endchoice

    menu "UART Configuration"
        depends on EXAMPLE_CONNECT_PPP_DEVICE_UART
        config EXAMPLE_CONNECT_UART_TX_PIN
            int "TXD Pin Number"
            default 4
            range 0 31
            help
                Pin number of UART TX.

        config EXAMPLE_CONNECT_UART_RX_PIN
            int "RXD Pin Number"
            default 5
            range 0 31
            help
                Pin number of UART RX.

        config EXAMPLE_CONNECT_UART_BAUDRATE
            int "UART Baudrate"
            default 115200
            range 9600 3000000
            help
                Baudrate of the UART device

    endmenu

    config EXAMPLE_PPP_CONN_MAX_RETRY
        int "Maximum retry"
        default 6
        help
            Set the Maximum retry to avoid station reconnecting if the pppd
            is not available


endmenu
```

## sta-ap/main/Kconfig.projbuild
```kconfig
menu "Example Configuration"

    menu "AP Configuration"
        comment "AP Configuration"

        config EXAMPLE_WIFI_SSID
            string "Wi-Fi SSID"
            default "sta2ap"
            help
                Set the SSID of Wi-Fi ap interface.

        config EXAMPLE_WIFI_PASSWORD
            string "Wi-Fi Password"
            default "12345678"
            help
                Set the password of Wi-Fi ap interface.

        config EXAMPLE_WIFI_CHANNEL
            int "WiFi channel"
            range 1 13
            default 1
            help
                Set the channel of Wi-Fi ap.

    endmenu

    menu "STA Configuration"
        comment "STA Configuration"

        config EXAMPLE_WIFI_STA_SSID
            string "WiFi Station SSID"
            default "myssid"
            help
                SSID for the example's sta to connect to.

        config EXAMPLE_WIFI_STA_PASSWORD
            string "WiFi Station Password"
            default "mypassword"
            help
                WiFi station password for the example to use.

        config EXAMPLE_MAXIMUM_STA_RETRY
            int "Maximum retry"
            default 5
            help
                Set the maximum retry value to prevent the station from continuously
                attempting to reconnect to the Access Point (AP) when the AP doesn't exist.
    endmenu

    config EXAMPLE_MODIFY_DHCP_MESSAGES
        bool "Modify DHCP messages"
        default y
        help
            This is needed if the client uses 61 option and the DHCP server applies strict rules
            on assigning addresses.
            Set this to 'n' if you don't need DHCP or you're using simplified DHCP workflow
            without HW address options in DHCP messages.

endmenu
```

## wifi-stubborn/main/Kconfig.projbuild
```kconfig
menu "Example Configuration"

    config EXAMPLE_FIRMWARE_UPGRADE_URL
        string "firmware upgrade url endpoint"
        default "https://192.168.0.3:8070/hello_world.bin"
        help
            URL of server which hosts the firmware
            image.

    menu "STA Configuration"
        comment "STA Configuration"

        config EXAMPLE_STA_SSID
            string "WiFi Station SSID"
            default "mystationssid"
            help
                SSID for the example's sta to connect to.

        config EXAMPLE_STA_PASSWORD
            string "WiFi Station Password"
            default "mystationpassword"
            help
                WiFi station password for the example to use.
    endmenu

endmenu
```

## wifi-stubborn/sdkconfig.defaults
```kconfig
CONFIG_ESPTOOLPY_FLASHSIZE_4MB=y
CONFIG_PARTITION_TABLE_TWO_OTA=y
CONFIG_EXAMPLE_FIRMWARE_UPGRADE_URL="https://192.168.0.32:1234/esp32.bin"
CONFIG_ESP_TLS_INSECURE=y
CONFIG_ESP_TLS_SKIP_SERVER_CERT_VERIFY=y
CONFIG_ESP_HTTPS_OTA_ALLOW_HTTP=y
```
